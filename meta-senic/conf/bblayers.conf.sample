## meta-senic/conf/bblayers.conf.sample
```bitbake
# LAYER_CONF_VERSION is increased each time build/conf/bblayers.conf
# changes incompatibly
LCONF_VERSION = "7"

BBPATH = "${TOPDIR}"
BBFILES ?= ""

BBLAYERS ?= " \
	##OEROOT##/meta \
	##OEROOT##/../meta-senic \
	##OEROOT##/../meta-openembedded/meta-oe \
	##OEROOT##/../meta-openembedded/meta-networking \
	##OEROOT##/../meta-openembedded/meta-python \
	##OEROOT##/../meta-mender/meta-mender-core \
"
```

## meta-senic/conf/distro/senic.conf
```bitbake
DISTRO_NAME = "senic"

IMAGE_LINGUAS = "en-us"

DISTRO_FEATURES = "${DISTRO_FEATURES_DEFAULT} ${DISTRO_FEATURES_LIBC} usb bluetooth wifi"
DISTRO_TYPE ?= "release"

# Enable systemd exclusively
DISTRO_FEATURES_append = " systemd"
VIRTUAL-RUNTIME_init_manager = "systemd"
DISTRO_FEATURES_BACKFILL_CONSIDERED = "sysvinit"
VIRTUAL-RUNTIME_initscripts = ""

INHERIT += "mender-full"
```

## meta-senic/conf/layer.conf
```bitbake
# We have a conf and classes directory, append to BBPATH
BBPATH .= ":${LAYERDIR}"

# We have a recipes directory, add to BBFILES
BBFILES += "${LAYERDIR}/recipes*/*/*.bb ${LAYERDIR}/recipes*/*/*.bbappend"

BBFILE_COLLECTIONS += "senic"
BBFILE_PATTERN_senic := "^${LAYERDIR}/"
BBFILE_PRIORITY_senic = "6"

LICENSE_PATH += "${LAYERDIR}/licenses"

LAYERDEPENDS_senic = "core"
```

## meta-senic/conf/local.conf.sample
```bitbake
MACHINE = "senic-hub"
DISTRO = "senic-dev"
# actual version is set during build process, this is just a placeholder
DISTRO_VERSION = "XXX"
TARGET_VENDOR = "-senic"
MAINTAINER = "Senic GmbH <hi@senic.com>"

# shared locations
DL_DIR ?= "/var/senic/shared/downloads"
SSTATE_DIR ?= "/var/senic/shared/sstate-cache"

PACKAGE_CLASSES ?= "package_ipk"

#  "debug-tweaks"   - make an image suitable for development
#                     e.g. ssh root access has a blank password
# There are other application targets that can be used here too, see
# meta/classes/image.bbclass and meta/classes/core-image.bbclass for more details.
# We default to enabling the debugging tweaks.
# EXTRA_IMAGE_FEATURES ?= "debug-tweaks"

USER_CLASSES ?= "buildstats image-mklibs image-prelink"

# make compatible with running builds inside screen
OE_TERMINAL = "screen"
# By default disable interactive patch resolution (tasks will just fail instead):
PATCHRESOLVE = "noop"

BB_DISKMON_DIRS = "\
    STOPTASKS,${TMPDIR},1G,100K \
    STOPTASKS,${DL_DIR},1G,100K \
    STOPTASKS,${SSTATE_DIR},1G,100K \
    STOPTASKS,/tmp,100M,100K \
    ABORT,${TMPDIR},100M,1K \
    ABORT,${DL_DIR},100M,1K \
    ABORT,${SSTATE_DIR},100M,1K \
    ABORT,/tmp,10M,1K"
PACKAGECONFIG_append_pn-qemu-native = " sdl"
PACKAGECONFIG_append_pn-nativesdk-qemu = " sdl"

# CONF_VERSION is increased each time build/conf/ changes incompatibly and is used to
# track the version of this file when it was generated. This can safely be ignored if
# this doesn't mean anything to you.
CONF_VERSION = "1"

# For Mender integration
#
MENDER_ARTIFACT_NAME = "${DISTRO_VERSION}"
# we exceed the default size, so we must set it explicitly
MENDER_STORAGE_TOTAL_SIZE_MB = "1036"
# squeeze some more size by reducing the data partition
MENDER_DATA_PART_SIZE_MB = "10"
MENDER_DATA_PART_DIR_append = " ${DEPLOY_DIR_IMAGE}/hub-data"
MENDER_UPDATE_POLL_INTERVAL_SECONDS = "225"
MENDER_INVENTORY_POLL_INTERVAL_SECONDS = "150"

# Setting these variables is a hard dependency for the hub-configuration recipe
# Please fetch the values from 1 password (Sw build - security steps).
# The recipe will fail if they remain empty.
SNC_SONOS_API_KEY = ""
SNC_SENTRY_DSN = ""
SNC_MIXPANEL_TOKEN = ""
```

## meta-senic/conf/machine/senic-hub.conf
```bitbake
#@TYPE: Machine
#@NAME: senic-hub
#@DESCRIPTION: Machine configuration for Senic Hub that is based on NanoPi NEO v1.3 + Baseboard

include conf/machine/include/soc-family.inc
require conf/machine/include/tune-cortexa7.inc

SOC_FAMILY = "sun8i"
DEFAULTTUNE = "cortexa7hf-neon-vfpv4"

# Kernel
PREFERRED_PROVIDER_virtual/kernel ?= "linux"
KERNEL_IMAGETYPE = "zImage"
KERNEL_DEVICETREE = "sun8i-h3-senic-hub.dtb"
SERIAL_CONSOLE = "115200 ttyS0"

# Install kernel and devicetree
RDEPENDS_kernel-base += "kernel-image kernel-devicetree"

# Bootloader
PREFERRED_PROVIDER_virtual/bootloader = "u-boot"
PREFERRED_PROVIDER_u-boot = "u-boot"
UBOOT_ARCH = "arm"
UBOOT_MACHINE = "senic_hub_defconfig"

# Mender versions
PREFERRED_VERSION_mender = "1.5.0"
PREFERRED_VERSION_mender-artifact = "2.2.0"
PREFERRED_VERSION_mender-artifact-native = "2.2.0"

# Mender sdimg
IMAGE_BOOTLOADER_BOOTSECTOR_OFFSET = "16"
IMAGE_BOOTLOADER_FILE = "u-boot-sunxi-with-spl.bin"

PREFERRED_PROVIDER_u-boot-fw-utils = "u-boot-fw-utils-mender-auto-provided"

# To build the u-boot image
EXTRA_IMAGEDEPENDS += "virtual/bootloader"

# Add Bluetooth as machine features as USB dongles will be used
MACHINE_FEATURES += "bluetooth wifi"

# the rtc feature is incompatible with our packagroup constellation, so we must disable it
# (also our board doesn't have a realtime clock anyway...)
MACHINE_FEATURES_BACKFILL_CONSIDERED = "rtc"

# To create an image to deploy it on a SD-card
IMAGE_FSTYPES = "ext4"
EXTRA_IMAGEDEPENDS += "dosfstools-native mtools-native"
MACHINE_EXTRA_RDEPENDS += "kernel-modules"
```
